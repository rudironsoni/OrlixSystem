## Linux/ports/orlix/configs/enterprise_defconfig
```kconfig
CONFIG_ORLIX=y
CONFIG_ORLIX_BLOCK=y
CONFIG_ORLIX_TTY=y
CONFIG_ORLIX_CHAR=y
CONFIG_BLOCK=y
CONFIG_TTY=y
CONFIG_UNIX98_PTYS=y
CONFIG_NET=y
CONFIG_SYSVIPC=y
CONFIG_POSIX_MQUEUE=y
CONFIG_DEVTMPFS=y
CONFIG_DEVTMPFS_MOUNT=y
CONFIG_BLK_DEV_INITRD=y
CONFIG_PROC_FS=y
CONFIG_SYSFS=y
CONFIG_CGROUPS=y
CONFIG_NAMESPACES=y
CONFIG_UTS_NS=y
CONFIG_IPC_NS=y
CONFIG_USER_NS=y
CONFIG_PID_NS=y
CONFIG_NET_NS=y
# CONFIG_SECCOMP is not set
# CONFIG_SECCOMP_FILTER is not set
CONFIG_TMPFS=y
CONFIG_EXT4_FS=y
CONFIG_INET=y
CONFIG_UNIX=y
CONFIG_BINFMT_SCRIPT=y
CONFIG_BINFMT_ELF=y
# CONFIG_MODULES is not set
```

## Linux/ports/orlix/overlay/arch/orlix/Kconfig
```kconfig
config ORLIX
	bool "Orlix architecture"
	default y
	select GENERIC_IRQ_SHOW
	select HAVE_PAGE_SIZE_4KB
	select OF
	select HAS_IOMEM
	select HAS_DMA

config 64BIT
	bool
	default y

config MMU
	bool
	default y

config PGTABLE_LEVELS
	int
	default 4

config GENERIC_CSUM
	def_bool y

config GENERIC_CALIBRATE_DELAY
	def_bool y

config GENERIC_HWEIGHT
	def_bool y

source "kernel/Kconfig.hz"
```

## Linux/ports/orlix/overlay/drivers/orlix/Kconfig
```kconfig
menu "Orlix drivers"

source "drivers/orlix/block/Kconfig"
source "drivers/orlix/tty/Kconfig"
source "drivers/orlix/char/Kconfig"

endmenu
```

## Linux/ports/orlix/overlay/drivers/orlix/block/Kconfig
```kconfig
config ORLIX_BLOCK
	bool "Orlix block devices"
	help
	  Enable Orlix Linux block device skeletons.
```

## Linux/ports/orlix/overlay/drivers/orlix/char/Kconfig
```kconfig
menu "Orlix character drivers"

config ORLIX_CHAR_RANDOM
	tristate "Orlix random character device"
	help
	  Build the Orlix random character device skeleton.

endmenu
```

## Linux/ports/orlix/overlay/drivers/orlix/tty/Kconfig
```kconfig
menu "Orlix tty drivers"

config ORLIX_TTY_CONSOLE
	tristate "Orlix console tty"
	help
	  Build the Orlix console tty skeleton.

endmenu
```

## OrlixKernel/Sources/ports/orlix/configs/appstore_defconfig
```kconfig
CONFIG_ORLIX=y
CONFIG_OF=y
CONFIG_VIRTIO=y
CONFIG_VIRTIO_MMIO=y
CONFIG_VIRTIO_BLK=y
CONFIG_VIRTIO_CONSOLE=y
CONFIG_ORLIX_VIRTIO_MMIO=y
CONFIG_ORLIX_TTY=y
CONFIG_ORLIX_CHAR=y
CONFIG_BLOCK=y
CONFIG_TTY=y
CONFIG_UNIX98_PTYS=y
CONFIG_NET=y
CONFIG_NETDEVICES=y
# CONFIG_PTP_1588_CLOCK is not set
CONFIG_SYSVIPC=y
CONFIG_POSIX_MQUEUE=y
CONFIG_DEVTMPFS=y
CONFIG_DEVTMPFS_MOUNT=y
CONFIG_PAGE_SIZE_16KB=y
CONFIG_BLK_DEV_INITRD=y
CONFIG_INITRAMFS_SOURCE="$(srctree)/arch/orlix/boot/initramfs/no-init.list"
CONFIG_PROC_FS=y
CONFIG_SYSFS=y
CONFIG_CGROUPS=y
CONFIG_NAMESPACES=y
CONFIG_UTS_NS=y
CONFIG_IPC_NS=y
CONFIG_USER_NS=y
CONFIG_PID_NS=y
CONFIG_NET_NS=y
# CONFIG_SECCOMP is not set
# CONFIG_SECCOMP_FILTER is not set
CONFIG_TMPFS=y
CONFIG_TMPFS_XATTR=y
CONFIG_EXT4_FS=y
CONFIG_OVERLAY_FS=y
CONFIG_INET=y
CONFIG_UNIX=y
CONFIG_BINFMT_SCRIPT=y
CONFIG_BINFMT_ELF=y
# CONFIG_BPF_JIT is not set
# CONFIG_DEVMEM is not set
# CONFIG_MODULES is not set
```

## OrlixKernel/Sources/ports/orlix/configs/release_defconfig
```kconfig
CONFIG_ORLIX=y
CONFIG_OF=y
CONFIG_VIRTIO=y
CONFIG_VIRTIO_MMIO=y
CONFIG_VIRTIO_BLK=y
CONFIG_VIRTIO_CONSOLE=y
CONFIG_HW_RANDOM=y
CONFIG_HW_RANDOM_VIRTIO=y
CONFIG_ORLIX_VIRTIO_MMIO=y
CONFIG_ORLIX_TTY=y
CONFIG_BLOCK=y
CONFIG_BLK_DEV_LOOP=y
CONFIG_TTY=y
CONFIG_UNIX98_PTYS=y
CONFIG_NET=y
CONFIG_NETDEVICES=y
# CONFIG_PTP_1588_CLOCK is not set
CONFIG_SYSVIPC=y
CONFIG_POSIX_MQUEUE=y
CONFIG_DEVTMPFS=y
CONFIG_DEVTMPFS_MOUNT=y
CONFIG_PAGE_SIZE_16KB=y
CONFIG_BLK_DEV_INITRD=y
CONFIG_INITRAMFS_SOURCE="$(srctree)/arch/orlix/boot/initramfs/no-init.list"
CONFIG_PROC_FS=y
CONFIG_SYSFS=y
CONFIG_CGROUPS=y
CONFIG_NAMESPACES=y
CONFIG_UTS_NS=y
CONFIG_IPC_NS=y
CONFIG_USER_NS=y
CONFIG_PID_NS=y
CONFIG_NET_NS=y
# CONFIG_SECCOMP is not set
# CONFIG_SECCOMP_FILTER is not set
CONFIG_TMPFS=y
CONFIG_TMPFS_XATTR=y
CONFIG_TMPFS_POSIX_ACL=y
CONFIG_EXT4_FS=y
CONFIG_EXT4_FS_POSIX_ACL=y
CONFIG_OVERLAY_FS=y
CONFIG_INET=y
CONFIG_UNIX=y
CONFIG_AUDIT=y
CONFIG_SECURITY=y
CONFIG_SECURITYFS=y
CONFIG_SECURITY_NETWORK=y
CONFIG_SECURITY_SELINUX=y
CONFIG_SECURITY_SELINUX_BOOTPARAM=y
CONFIG_DEFAULT_SECURITY_SELINUX=y
CONFIG_LSM="selinux"
CONFIG_EXT4_FS_SECURITY=y
CONFIG_BINFMT_SCRIPT=y
CONFIG_BINFMT_ELF=y
CONFIG_HZ_100=y
CONFIG_HIGH_RES_TIMERS=y
# CONFIG_BPF_JIT is not set
# CONFIG_DEVMEM is not set
# CONFIG_MODULES is not set
```

## OrlixKernel/Sources/ports/orlix/overlay/arch/orlix/Kconfig
```kconfig
config ORLIX
	bool "Orlix architecture"
	default y
	select GENERIC_IRQ_SHOW
	select IRQ_DOMAIN
	select HAVE_PAGE_SIZE_4KB
	select HAVE_PAGE_SIZE_16KB
	select OF
	select OF_IRQ
	select HAS_IOMEM
	select HAS_DMA
	select ARCH_WANT_FRAME_POINTERS
	select GENERIC_CPU_DEVICES
	select LOCK_MM_AND_FIND_VMA
	select CLONE_BACKWARDS

config 64BIT
	bool
	default y

config MMU
	bool
	default y

config PGTABLE_LEVELS
	int
	default 4

config GENERIC_CSUM
	def_bool y

config GENERIC_CALIBRATE_DELAY
	def_bool y

config GENERIC_HWEIGHT
	def_bool y

config ORLIX_HOSTED_ASYNC_USER_TIMER
	bool
	default y

source "kernel/Kconfig.hz"
```

## OrlixKernel/Sources/ports/orlix/overlay/arch/orlix/Kconfig.debug
```kconfig
# SPDX-License-Identifier: GPL-2.0-only

config ORLIX_BOOT_KUNIT_TEST
	bool "KUnit test for Orlix boot handoff" if !KUNIT_ALL_TESTS
	depends on KUNIT=y
	default KUNIT_ALL_TESTS
	help
	  Test the Orlix architecture boot handoff state with KUnit.
```

## OrlixKernel/Sources/ports/orlix/overlay/drivers/orlix/Kconfig
```kconfig
menu "Orlix drivers"

depends on ORLIX

source "drivers/orlix/block/Kconfig"
source "drivers/orlix/virtio/Kconfig"
source "drivers/orlix/tty/Kconfig"
source "drivers/orlix/char/Kconfig"

endmenu
```

## OrlixKernel/Sources/ports/orlix/overlay/drivers/orlix/char/Kconfig
```kconfig
config ORLIX_CHAR
	bool "Orlix character devices"
	help
	  Enable Orlix Linux character device skeletons.
```

## OrlixKernel/Sources/ports/orlix/overlay/drivers/orlix/tty/Kconfig
```kconfig
config ORLIX_TTY
	bool "Orlix TTY devices"
	help
	  Enable Orlix Linux TTY skeletons.
```

## OrlixKernel/Sources/ports/orlix/overlay/drivers/orlix/virtio/Kconfig
```kconfig
config ORLIX_VIRTIO_MMIO
	bool "Orlix hosted virtio-mmio transport"
	depends on ORLIX
	depends on VIRTIO_MMIO
	help
	  Provide the Orlix-hosted virtio-mmio backend mechanics behind
	  normal Linux virtio-mmio device-tree nodes.
```
